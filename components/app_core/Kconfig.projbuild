## components/board_cores3/Kconfig.projbuild
```kconfig
menu "Board Configuration"
    config BOARD_M5STACK_CORES3
        bool "M5Stack CoreS3"
        default y

    config BOARD_TARGET_PATH
        string
        default "board_cores3"
endmenu
```

## components/dac_tas58xx/Kconfig
```kconfig
if DAC_TAS58XX

    config TAS58XX_EQ_ENABLED
        bool "Enable 15-band parametric EQ"
        default y
        help
            Compile the pre-computed biquad coefficient tables for
            the 15-band parametric equalizer. Disabling saves ~9.3 KB
            of Flash but removes EQ support.

    config TAS58XX_MAX_VOLUME
        int "Maximum DAC volume (dB)"
        range -100 0
        default -10
        help
            Maximum volume level in dB that corresponds to AirPlay volume 0 dB.
            The TAS5825M DIG_VOL register range is +24 dB to -103 dB.
            A value of -10 means AirPlay full volume maps to -10 dB on the DAC.

endif # DAC_TAS58XX
```
