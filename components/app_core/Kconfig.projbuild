## main/Kconfig.projbuild
```kconfig
menu "Airplay ESP Configuration"
    # Board configuration is now in components/boards/Kconfig.projbuild

    menu "Product Profile"
        config PRODUCT_AIRPLAY_ONLY
            bool "Build as AirPlay-first receiver"
            default y
            help
                Optimizes the default product profile for AirPlay playback,
                minimal setup/status management, and reduced background
                services. Optional diagnostics remain available via
                dedicated development switches.

        config ENABLE_DEV_DIAGNOSTICS
            bool "Expose development diagnostics UI and endpoints"
            default n
            help
                Enables the advanced web console, log streaming, file
                management, OTA, and other diagnostics endpoints. Keep
                disabled for the default product build.

        config USB_WEB_CONTROL
            bool "Enable USB Web Serial management surface"
            default y if BOARD_M5STACK_CORES3
            default n
            help
                Enables the JSON-line USB control channel intended for the
                computer-hosted Chromium Web Serial management page.

        config STRUCTURED_TRACE_ENABLE
            bool "Emit structured JSON Lines for handshake tracing"
            default y if ENABLE_DEV_DIAGNOSTICS
            help
                Emits a second, machine-readable event stream for burning/
                bring-up validation. The stream is intended for UART or USB
                capture and should stay disabled in release builds.
    endmenu

    menu "Security"
        config WEB_AUTH_REQUIRED
            bool "Require authentication for web management"
            default y
            help
                When enabled, the device exposes only setup endpoints while in
                captive-portal/AP mode. Management APIs on the normal network
                require a short-lived session token obtained via /api/auth/login.

        config ALLOW_INSECURE_RAW_PAIR_VERIFY
            bool "Allow insecure raw pair-verify compatibility mode"
            default n
            help
                Enables the legacy raw AirPlay pair-verify flow that cannot
                fully authenticate the client signature. Leave disabled unless
                you explicitly need compatibility with an old sender.

        config OTA_SIGNATURE_REQUIRED
            bool "Require OTA signature verification"
            default n
            help
                Placeholder switch for deployments that want to layer detached
                signature verification on top of the built-in ESP image checks.
                When enabled, unsigned uploads are rejected.
    endmenu
    
    menu "LED Configuration"
        config LED_STATUS_BRIGHTNESS
            int "Status LED brightness (0-100% duty for the on phase)"
            range 0 255
            default 60
            help
                Brightness level for the status LED (0=off, 255=max).

        menu "Status LED Behavior"
            choice LED_STATUS_ON_PLAYING
                prompt "Status LED when playing"
                default LED_STATUS_PLAYING_STEADY

                config LED_STATUS_PLAYING_STEADY
                    bool "Steady"
                config LED_STATUS_PLAYING_BLINK_FAST
                    bool "Blink fast"
                config LED_STATUS_PLAYING_VU
                    bool "VU meter"
            endchoice

            choice LED_STATUS_ON_PAUSED
                prompt "Status LED when paused"
                default LED_STATUS_PAUSED_BLINK_MEDIUM

                config LED_STATUS_PAUSED_OFF
                    bool "Off"
                config LED_STATUS_PAUSED_STEADY
                    bool "Steady"
                config LED_STATUS_PAUSED_BLINK_SLOW
                    bool "Blink slow"
                config LED_STATUS_PAUSED_BLINK_MEDIUM
                    bool "Blink medium"
            endchoice

            choice LED_STATUS_ON_STANDBY
                prompt "Status LED when standby"
                default LED_STATUS_STANDBY_BLINK_SLOW

                config LED_STATUS_STANDBY_OFF
                    bool "Off"
                config LED_STATUS_STANDBY_BLINK_SLOW
                    bool "Blink slow"
                config LED_STATUS_STANDBY_BLINK_MEDIUM
                    bool "Blink medium"
            endchoice
        endmenu

        menu "RGB LED Behavior"
            choice LED_RGB_ON_PLAYING
                prompt "RGB LED when playing"
                default LED_RGB_PLAYING_VU

                config LED_RGB_PLAYING_OFF
                    bool "Off"
                config LED_RGB_PLAYING_STEADY
                    bool "Steady color"
                config LED_RGB_PLAYING_VU
                    bool "VU meter"
            endchoice

            choice LED_RGB_ON_PAUSED
                prompt "RGB LED when paused"
                default LED_RGB_PAUSED_STEADY

                config LED_RGB_PAUSED_OFF
                    bool "Off"
                config LED_RGB_PAUSED_STEADY
                    bool "Steady color"
            endchoice

            choice LED_RGB_ON_STANDBY
                prompt "RGB LED when standby"
                default LED_RGB_STANDBY_OFF

                config LED_RGB_STANDBY_OFF
                    bool "Off"
                config LED_RGB_STANDBY_STEADY
                    bool "Steady color"
            endchoice

            config LED_RGB_COLOR_PAUSED
                hex "RGB color when paused (hex)"
                default 0x000033
                help
                    RGB color in hex (0xRRGGBB) for paused state.

            config LED_RGB_COLOR_STANDBY
                hex "RGB color when standby (hex)"
                default 0x001100
                help
                    RGB color in hex (0xRRGGBB) for standby state.
        endmenu
    endmenu

    menu "WiFi Configuration"
    config DEFAULT_AP_SSID
        string "Access Point SSID"
        default "ESP32-AirPlay-Setup"
        help
            SSID (network name) the ESP32 will broadcast.

    config DEFAULT_AP_PASSWORD
        string "Access Point Password"
        default ""
        help
            Password used for the Access Point. Leave empty and set AUTH MODE to WIFI_AUTH_OPEN for no password.

    config DEFAULT_AP_CHANNEL
        int "Access Point WiFi Channel"
        default 1
        help
            Be careful you might not see the access point if you use a channel not allowed in your country.

    config WIFI_FACTORY_DEFAULT_ENABLE
        bool "Seed NVS with factory STA credentials if none saved"
        default n
        help
            On boot, if NVS has no saved STA SSID, write WIFI_FACTORY_SSID and
            WIFI_FACTORY_PASSWORD once. Use for lab or single-home images; secrets
            live in sdkconfig — do not publish builds you do not trust.

    config WIFI_FACTORY_SSID
        string "Factory STA WiFi SSID"
        depends on WIFI_FACTORY_DEFAULT_ENABLE
        default ""
        help
            Written to NVS only when no WiFi credentials exist yet.

    config WIFI_FACTORY_PASSWORD
        string "Factory STA WiFi password"
        depends on WIFI_FACTORY_DEFAULT_ENABLE
        default ""
        help
            Written together with WIFI_FACTORY_SSID when seeding NVS.
    endmenu

    menu "Audio Output"
    config AUDIO_TARGET_LATENCY_MS
        int "Target playout latency (ms)"
        range 80 1000
        default 180
        help
            Best-effort target for total receiver latency. Used for telemetry
            and buffer sizing defaults.

    config AUDIO_MAX_BUFFER_MS
        int "Maximum queued audio depth (ms)"
        range 80 2000
        default 240
        help
            Caps the jitter/reorder buffer depth to keep memory bounded and
            avoid accumulating excess latency under poor network conditions.

    choice OUTPUT_SAMPLE_RATE
        prompt "Output sample rate"
        default OUTPUT_SAMPLE_RATE_44100
        depends on !DAC_TAS57XX && !DAC_TAS58XX
        help
            Sample rate for audio output. If the AirPlay source
            sends a different rate, the audio is resampled automatically.

        config OUTPUT_SAMPLE_RATE_44100
            bool "44100 Hz (native AirPlay, no resampling)"
        config OUTPUT_SAMPLE_RATE_48000
            bool "48000 Hz (resampled from 44100)"
    endchoice

    config OUTPUT_SAMPLE_RATE_HZ
        int
        default 44100 if OUTPUT_SAMPLE_RATE_44100
        default 48000 if OUTPUT_SAMPLE_RATE_48000
        default 44100

    config RESAMPLER_TAPS
        int "Resampler filter taps (quality)" if OUTPUT_SAMPLE_RATE_48000
        range 4 64
        default 28 if IDF_TARGET_ESP32S3
        default 12 if IDF_TARGET_ESP32
        default 16
        help
            Number of taps for the sinc resampler filters.
            More taps = better quality but higher CPU cost.
            Must be a multiple of 4.
            ESP32-S3 (hardware FPU): 28 recommended.
            ESP32 (no FPU): 12 recommended.

    endmenu

    menu "Bluetooth Configuration"
        depends on BT_A2DP_ENABLE

        config BT_PIN_CODE
            string "Bluetooth pairing PIN code"
            default "05032026"
            help
                Static PIN code used for legacy Bluetooth pairing.
                Must be 1-16 digits. Connecting devices will be
                prompted to enter this PIN.

        config BT_SSP_ENABLED
            bool "Enable Secure Simple Pairing (SSP)"
            default n
            help
                Enable SSP for Bluetooth 2.1+ devices. When enabled,
                modern devices use numeric comparison (both sides
                confirm a displayed number) instead of the legacy PIN.
                A screen is required for this.
    endmenu

    menu "Display Configuration"
        config DISPLAY_ENABLED
            bool "Enable OLED display"
            default n
            help
                Enable an I2C or SPI OLED display for showing track metadata,
                playback position, and a progress bar.

        if DISPLAY_ENABLED
            choice DISPLAY_DRIVER
                prompt "Display driver"
                default DISPLAY_DRIVER_SSD1306
                help
                    Select the OLED display controller IC.

                config DISPLAY_DRIVER_SSD1306
                    bool "SSD1306 (128x64)"
                config DISPLAY_DRIVER_SH1106
                    bool "SH1106 (128x64)"
                config DISPLAY_DRIVER_SSD1309
                    bool "SSD1309 (128x64)"
                config DISPLAY_DRIVER_SH1107
                    bool "SH1107 (128x128)"
            endchoice

            choice DISPLAY_HEIGHT
                prompt "Display height"
                default DISPLAY_HEIGHT_64
                help
                    Select the display pixel height. 128x32 displays use
                    a compact two-line layout with scrolling text.

                config DISPLAY_HEIGHT_64
                    bool "64 pixels (128x64)"
                config DISPLAY_HEIGHT_32
                    bool "32 pixels (128x32)"
                    depends on !DISPLAY_DRIVER_SSD1309 && !DISPLAY_DRIVER_SH1107
            endchoice

            choice DISPLAY_BUS
                prompt "Display bus"
                default DISPLAY_BUS_I2C
                help
                    Select the communication bus for the display.

                config DISPLAY_BUS_I2C
                    bool "I2C"
                config DISPLAY_BUS_SPI
                    bool "SPI"
            endchoice

            if DISPLAY_BUS_I2C
                config DISPLAY_I2C_SDA
                    int "Display I2C SDA GPIO"
                    default 21
                    help
                        GPIO pin for the display I2C data line.

                config DISPLAY_I2C_SCL
                    int "Display I2C SCL GPIO"
                    default 22
                    help
                        GPIO pin for the display I2C clock line.

                config DISPLAY_I2C_ADDR
                    hex "Display I2C address (7-bit)"
                    default 0x3C
                    help
                        7-bit I2C address of the OLED display.
                        Common values: 0x3C or 0x3D.
            endif

            if DISPLAY_BUS_SPI
                config DISPLAY_SPI_CLK
                    int "Display SPI CLK GPIO"
                    default 18
                    help
                        GPIO pin for the display SPI clock line.

                config DISPLAY_SPI_MOSI
                    int "Display SPI MOSI GPIO"
                    default 23
                    help
                        GPIO pin for the display SPI data (MOSI) line.

                config DISPLAY_SPI_CS
                    int "Display SPI CS GPIO"
                    default 5
                    help
                        GPIO pin for the display SPI chip select.

                config DISPLAY_SPI_DC
                    int "Display SPI DC GPIO"
                    default 16
                    help
                        GPIO pin for the display SPI data/command select.

                config DISPLAY_SPI_RST
                    int "Display SPI RST GPIO"
                    default -1
                    help
                        GPIO pin for the display reset line.
                        Set to -1 if not connected.
            endif

            config DISPLAY_FLIP
                bool "Flip display 180 degrees"
                default n
                help
                    Rotate the display output 180 degrees.

            config DISPLAY_UPDATE_MS
                int "Display refresh interval (ms)"
                default 500
                range 100 5000
                help
                    How often the display redraws in milliseconds.
        endif
    endmenu

    menu "AirPlay Protocol"
        config AIRPLAY_FORCE_V1
            bool "Force AirPlay v1 (classic) protocol"
            default y
            help
                Advertise as a classic AirPlay 1 (RAOP) device. Enables
                DACP remote control — iOS sends DACP-ID and Active-Remote
                headers in AirPlay 1 mode, allowing hardware buttons to
                control playback on the source device.
    endmenu

    menu "Button Configuration"
        config BTN_PLAY_PAUSE_GPIO
            int "Play/Pause button GPIO (-1 to disable)"
            default -1
            range -1 48
            help
                GPIO pin for the play/pause button (active-low, internal pull-up).
                Set to -1 to disable.

        config BTN_VOLUME_UP_GPIO
            int "Volume Up button GPIO (-1 to disable)"
            default -1
            range -1 48
            help
                GPIO pin for the volume up button (active-low, internal pull-up).
                Supports long-press auto-repeat.
                Set to -1 to disable.

        config BTN_VOLUME_DOWN_GPIO
            int "Volume Down button GPIO (-1 to disable)"
            default -1
            range -1 48
            help
                GPIO pin for the volume down button (active-low, internal pull-up).
                Supports long-press auto-repeat.
                Set to -1 to disable.

        config BTN_NEXT_GPIO
            int "Next Track button GPIO (-1 to disable)"
            default -1
            range -1 48
            help
                GPIO pin for the next track button (active-low, internal pull-up).
                Set to -1 to disable.

        config BTN_PREV_GPIO
            int "Previous Track button GPIO (-1 to disable)"
            default -1
            range -1 48
            help
                GPIO pin for the previous track button (active-low, internal pull-up).
                Set to -1 to disable.
    endmenu
endmenu
```
