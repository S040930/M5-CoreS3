## sdkconfig.defaults.m5cores3
```kconfig
# M5Stack CoreS3 target defaults
CONFIG_BOARD_M5STACK_CORES3=y
CONFIG_ESPTOOLPY_FLASHSIZE_16MB=y
CONFIG_ESPTOOLPY_FLASHSIZE="16MB"
CONFIG_ESPTOOLPY_MONITOR_BAUD=115200
CONFIG_SPIRAM_MODE_QUAD=y
# CONFIG_SPIRAM_MODE_OCT is not set

# Route the primary console to the built-in USB serial/JTAG port so startup
# logs are visible without an external UART adapter.
CONFIG_ESP_CONSOLE_USB_SERIAL_JTAG=y
CONFIG_ESP_CONSOLE_SECONDARY_NONE=y
# CONFIG_ESP_CONSOLE_UART_DEFAULT is not set
# CONFIG_ESP_CONSOLE_SECONDARY_USB_SERIAL_JTAG is not set

# iPhone / modern hotspots may use WPA3; STA must negotiate SAE when offered
CONFIG_ESP_WIFI_ENABLE_WPA3_SAE=y

# Wi‑Fi + esp_netif default handlers on sys_evt need more than default 2304 bytes
CONFIG_ESP_SYSTEM_EVENT_TASK_STACK_SIZE=4096

# Wi‑Fi credentials are developer-provisioned outside the firmware UX.
# Compile-time credentials will override NVS settings on each flash.
CONFIG_WIFI_CREDENTIALS_COMPILE_TIME=y
CONFIG_WIFI_SSID=""
CONFIG_WIFI_PASSWORD=""

# AirPlay 1 (classic RAOP) mode — forced unconditionally
CONFIG_AIRPLAY_FORCE_V1=y

# AirPlay core only: no local web UI, USB management surface, or OTA path.
# CONFIG_DEVICE_HTTP_SERVER is not set
# CONFIG_ENABLE_DEV_DIAGNOSTICS is not set
# CONFIG_WEB_OTA_UPDATE is not set
# CONFIG_USB_WEB_CONTROL is not set
# CONFIG_STRUCTURED_TRACE_ENABLE is not set
# CONFIG_HTTPD_WS_SUPPORT is not set
CONFIG_AUDIO_MAX_BUFFER_MS=150
CONFIG_AUDIO_TARGET_LATENCY_MS=150
```
